/*
 * Ручное управление CS: `make display-test MANUAL=1`.
 *
 * У ls0xx в SPI_DT_SPEC_INST_GET зашит delay = 0, то есть CS поднимается
 * впритык к первому такту и опускается впритык к последнему, а спад у Sharp
 * и применяет кадр. Снимаем cs-gpios с шины и дёргаем пин сами.
 *
 * serial-vcom-inversion снят, а инверсию VCOM приложение делает само между
 * кадрами. Причина — баг в ls0xx: если кадр идёт дольше LS0XX_MAX_BUS_WAIT_MSEC
 * (100 мс, а на 125 кГц кадр занимает 109 мс), VCOM-поток не дожидается
 * семафора, пишет в лог `memory display semaphore not available`, но всё
 * равно делает k_sem_give — отдаёт замок, которого не брал. Дальше пустая
 * команда влезает в середину кадра, вставляя два байта в поток строк, и
 * строки съезжают.
 */

&spi0 {
    /delete-property/ cs-gpios;
};

&nice_view {
    /delete-property/ serial-vcom-inversion;
};
