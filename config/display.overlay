/*
 * Правки поверх шилда nice_view. Докладывается через -DEXTRA_DTC_OVERLAY_FILE
 * (в отличие от DTC_OVERLAY_FILE не отменяет шилдовые оверлеи).
 */

&nice_view {
	/* Интервал инверсии VCOM — апстримный. Панель статику держит уверенно
	   (нетронутый экран не выцветает), пробовали 10 и 200 мс: на картинку
	   и на задержку обновления не влияет ни в одну сторону. */
	serial-vcom-interval = <33>;

	/* Апстримный 1 МГц клон не тянет: кадр приходил битым, экран белел.
	   250 кГц — рабочее значение, картинка держится стабильно. Ниже
	   опускаться незачем: 125 кГц (последняя ступень сетки SPIM
	   125k/250k/500k/1M) не изменили ничего. */
	spi-max-frequency = <250000>;
};

/*
 * Освобождаем P0.06 под сигнал выбора кристалла экрана.
 *
 * Шилд corne разводит на этот пин линию данных подсветки (spi3, WS2812),
 * а nice_view_adapter назначает туда же CS (`cs-gpios = <&pro_micro 1>`).
 * Контроллер spi3 объявлен okay и поднимается при старте даже без
 * ZMK_RGB_UNDERGLOW: драйвер SPI собран, узел активен. Захватив пин через
 * pinctrl, периферия перебивает управление из GPIO, и CS почти всегда стоит
 * не в том состоянии — кадры доходили до панели только случайно.
 *
 * Подсветка не используется, так что контроллер просто выключаем. Если она
 * когда-нибудь понадобится, придётся выбирать: либо RGB, либо nice!view —
 * пин на Corne общий, это ограничение платы, а не конфига.
 */
&spi3 {
	status = "disabled";
};

/*
 * CS на D0 (P0.08), а не на D1 (P0.06) из шилда nice_view_adapter.
 *
 * Так разведён 5-контактный разъём экрана на этой плате Corne — проверено
 * пинвокером (test/pinwalk): контакт CS отзывается на частоту пина D0, а на
 * D1 не отзывается вообще, притом что сам P0.06 сигнал выдаёт. С шилдовым
 * pro_micro 1 панель в клавиатуре кадр не защёлкивает, хотя SCK и MOSI до
 * разъёма доходят чисто (SCK — ровные 2 мкс на полупериод, 250 кГц).
 *
 * P0.08 свободен: это RX uart0, а тот в сборке disabled.
 */
&spi0 {
	cs-gpios = <&pro_micro 0 GPIO_ACTIVE_HIGH>;
};
